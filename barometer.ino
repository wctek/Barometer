/*

   barometer.ino - Piccolino Pressure & Temperature display using the BMP180 sensor add-on
   Visit http://piccolino.rocks to get this low cost sensor and add it to your Piccolino!
   
   This demo uses Sparkfun's SFE_BMP180 library ( https://github.com/sparkfun/BMP180_Breakout/tree/master/Libraries/Arduino/src )
   
   To install the library, make a folder called SFE_BMP180 in your ... Arduino/libraries 
   go into the folder and drop the SFE_BMP180.cpp and SFE_BMP180.h files. Restart the Arduino IDE and compile this demo.
   
   Written by Alex Sardo (wctek.com) for Piccolino -> http://piccolino.rocks
  
   Feel free to do whatever you want with it. Have fun!
   
*/

#include <Wire.h>
#include <SPI.h>
#include <Piccolino_OLED.h>
#include <Piccolino_RAM.h>
#include <SFE_BMP180.h>

// You will need to create an SFE_BMP180 object, here called "pressure":
SFE_BMP180 pressure;

// Piccolino OLED driver
Piccolino_OLED oled;
Piccolino_RAM ram;

//change the below ALTITUDE to your own location. In google, search for: altitude suburb,state (ie: altitude spring,texas)
//value must be in meters
#define ALTITUDE 37 // Spring, Texas is 37 meters (121ft)

// 4 images for the weather screen toggler
PROGMEM const unsigned char sunny [] = {
0x00, 0x00, 0x00, 0x00, 0x00, 0x00, 0x00, 0x00, 0x00, 0x00, 0x00, 0x00, 0x00, 0x00, 0x00, 0x00,
0x00, 0x00, 0x00, 0x00, 0x00, 0x00, 0x00, 0x00, 0x00, 0x00, 0x00, 0x00, 0x00, 0x00, 0x00, 0x00,
0x00, 0x00, 0x00, 0x00, 0x00, 0x00, 0x00, 0x00, 0x00, 0x00, 0x00, 0x01, 0x00, 0x00, 0x00, 0x00,
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0x00, 0x00, 0x00, 0x00, 0x00, 0x00, 0x00, 0x00, 0x00, 0x00, 0x00, 0x00, 0x00, 0x00, 0x00, 0x00
};

PROGMEM const unsigned char partlycloudy [] = {
0x00, 0x00, 0x00, 0x00, 0x00, 0x00, 0x00, 0x00, 0x00, 0x00, 0x00, 0x00, 0x00, 0x00, 0x00, 0x00,
0x00, 0x00, 0x00, 0x00, 0x00, 0x00, 0x00, 0x00, 0x00, 0x00, 0x00, 0x00, 0x00, 0x00, 0x00, 0x00,
0x00, 0x00, 0x00, 0x00, 0x00, 0x00, 0x00, 0x00, 0x00, 0x00, 0x00, 0x00, 0x00, 0x00, 0x00, 0x00,
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0x00, 0x00, 0x00, 0x00, 0x00, 0x00, 0x00, 0x00, 0x00, 0x00, 0x00, 0x00, 0x00, 0x00, 0x00, 0x00
};

PROGMEM const unsigned char cloudy [] = {
0x00, 0x00, 0x00, 0x00, 0x00, 0x00, 0x00, 0x00, 0x00, 0x00, 0x00, 0x00, 0x00, 0x00, 0x00, 0x00,
0x00, 0x00, 0x00, 0x00, 0x00, 0x00, 0x00, 0x00, 0x00, 0x00, 0x00, 0x00, 0x00, 0x00, 0x00, 0x00,
0x00, 0x00, 0x00, 0x00, 0x00, 0x00, 0x00, 0x00, 0x00, 0x00, 0x00, 0x00, 0x00, 0x00, 0x00, 0x00,
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0x00, 0x00, 0x00, 0x00, 0x00, 0x00, 0x00, 0x00, 0x00, 0x00, 0x00, 0x00, 0x00, 0x00, 0x00, 0x00
};

PROGMEM const unsigned char chancetstorms [] = {
0x00, 0x00, 0x00, 0x00, 0x00, 0x00, 0x00, 0x00, 0x00, 0x00, 0x00, 0x00, 0x00, 0x00, 0x00, 0x00,
0x00, 0x00, 0x00, 0x00, 0x00, 0x20, 0x00, 0x00, 0x00, 0x00, 0x00, 0x00, 0x03, 0x33, 0x00, 0x00,
0x00, 0x00, 0x00, 0x00, 0x23, 0x77, 0x00, 0x00, 0x00, 0x00, 0x00, 0x00, 0x33, 0xFF, 0x60, 0x00,
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0x00, 0x00, 0x00, 0x00, 0x00, 0x00, 0x00, 0x00, 0x00, 0x00, 0x00, 0x00, 0x00, 0x00, 0x00, 0x00
};

double T,P,p0,p1;
int looper=0;
byte local_buff[129];


// ---------------------------------- peogram starts here ----------------------------------------------

void drawBitmap(int16_t x, int16_t y, const unsigned char *bitmap, int16_t w, int16_t h) 
{
  int16_t i, j, byteWidth = (w + 7) / 8;
  for(j=0; j<h; j++) {
    for(i=0; i<w; i++ ) {
      if(pgm_read_byte(bitmap + j * byteWidth + i / 8) & (128 >> (i & 7))) {
        oled.drawPixel(x+i, y+j, WHITE);
      }
    }
  } 
}

void ShowTemp(char x,char y) 
{
      oled.setCursor(x-36,y);
      oled.setTextSize(3);
      oled.print(round((9.0/5.0)*T+32.0)); // don't print decimals
      oled.setCursor(x,y+1);
      oled.setTextSize(1);
      oled.println("F");
}

void setup()
{

  //power sensor via A2 (just above 3v is enough)
  pinMode(A2,OUTPUT);
  digitalWrite(A2,HIGH);
  
  ram.begin();  
  memset(local_buff,0,128);
  ram.write(0,local_buff,128);
  
  oled.begin();
  oled.clear();
  oled.print(F("Init..."));
  oled.update();
  
  // Initialize the sensor (it is important to get calibration values stored on the device).

  if (pressure.begin()) {
    oled.println(F("Ok!"));
    oled.update();
  }  else
  {
    // Oops, something went wrong, this is usually a connection problem,
    // see the comments at the top of this sketch for the proper connections.

    oled.println(F("FAILED"));
    oled.update();
    while(1)
      delay(10000); // Pause forever.
  }
  Serial.begin(9600);
}

void loop()
{
  char status;
  char p2;

  oled.clear();

  // You must first get a temperature measurement to perform a pressure reading.
 
  // Start a temperature measurement:
  // If request is successful, the number of ms to wait is returned.
  // If request is unsuccessful, 0 is returned.

  status = pressure.startTemperature();
  if (status != 0)
  {
    // Wait for the measurement to complete:
    delay(status);

    // Retrieve the completed temperature measurement:
    // Note that the measurement is stored in the variable T.
    // Function returns 1 if successful, 0 if failure.
    
    if (pressure.getTemperature(T))
        ShowTemp(36,0);  

  }
  
      if (status = pressure.startPressure(3))
      {
        // Wait for the measurement to complete:
        delay(status);

        // Retrieve the completed pressure measurement:
        // Note that the measurement is stored in the variable P.
        // Note also that the function requires the previous temperature measurement (T).
        // (If temperature is stable, you can do one temperature measurement for a number of pressure measurements.)
        // Function returns 1 if successful, 0 if failure.

        // The pressure sensor returns abolute pressure, which varies with altitude.
        // To remove the effects of altitude, use the sealevel function and your current altitude.
        // This number is commonly used in weather reports.

        if (pressure.getPressure(P,T))
        {
          // Print out the measurement:
          oled.setCursor(55,0);
          oled.setTextSize(2);
          
          p0 = pressure.sealevel(P,ALTITUDE); // corrected for your actual altitude
          p0*=0.0295333727;
          
          oled.print(p0);
          oled.setTextSize(1);
          oled.setCursor(114,8);
          oled.println(F("in"));
          
          oled.setCursor(60,19);
          oled.print(p0,2);
          oled.print(F(" mb"));

        }
      }

      // draw legend
      oled.setCursor(0,36);
      oled.print(F("    RAIN      FAIR"));
      oled.setCursor(0,56);
      oled.print(F("STORM   CHANGE   DRY"));
      
      p1=p0-28; // p0 = inHg - min of scale   (typical barometer range is 27.8 - 31.2 but we just track top part for better visualization on the graph)      
      p1*=10; // range is now 32 max
      p2=round(p1*100/32); // get percent of bar to be filled based on 128 pixels width 
      oled.fillRect(0,48,p2,5,WHITE); // draw bar

      // separation line in the middle of the screen
      oled.drawLine(0,32,127,32,WHITE);
      
      oled.update();  
      
      delay(1000); //wait 1 sec

      looper++;

     if(!(looper%300)) { // update history every 10 minutes (since we pause for 10 seconds every 10 seconds we only count 300 seconds)
       ram.read(1,local_buff,127); // skip first location
       local_buff[127]=14+(50-round(p2/2)); // scale output so that low pressure dips the graph down.
       ram.write(0,local_buff,128); //keep the last 24 hours approx  (60*60*24)/128 pixels is about 11 minutes per dot
       looper=0;
     }
     
     if(!(looper%10)) { // rotate screens every 10 seconds
       unsigned char f;       
       oled.clear();
       
       for(f=0; f<128; f++)
         oled.drawPixel(f,local_buff[f],WHITE);
         
       oled.setCursor(43,0);
       oled.setTextSize(1);
       oled.print("HISTORY");
       oled.setCursor(0,10);
       oled.print("SUNNY");
       oled.setCursor(0,54);
       oled.print("STORMY");
       oled.update();
       delay(5000);
       
       oled.clear();
       if(p0<28.7)            drawBitmap(64,0,chancetstorms,64,64);   
       if(p0>28.69&&p0<29.5)  drawBitmap(64,0,partlycloudy,64,64);
       if(p0>29.49&&p0<30.5)  drawBitmap(64,0,cloudy,64,64);
       if(p0>30.49)           drawBitmap(64,0,sunny,64,64);
       ShowTemp(50,20);  
       oled.update();
       delay(5000);
     }     
}

